## MSMS_Project - C3/component/core/PinManager/Kconfig.projbuild
```kconfig
menu "PinManager — UART"

    config PIN_UART_TX
        int "UART TX GPIO"
        default 16 if IDF_TARGET_ESP32
        default 5 if IDF_TARGET_ESP32C6
        default 3 if IDF_TARGET_ESP32C3
        help
            Chân TX (GPIO) của UART đã chọn (UART port bên dưới).

    config PIN_UART_RX
        int "UART RX GPIO"
        default 17 if IDF_TARGET_ESP32
        default 4 if IDF_TARGET_ESP32C6
        default 2 if IDF_TARGET_ESP32C3
        help
            Chân RX (GPIO).

    config PIN_UART_NUM
        int "UART port (UART_NUM_0=0, UART_NUM_1=1, UART_NUM_2=2)"
        range 0 2 if IDF_TARGET_ESP32
        range 0 1 if IDF_TARGET_ESP32C3
        range 0 1 if IDF_TARGET_ESP32C6
        default 2 if IDF_TARGET_ESP32
        default 1 if IDF_TARGET_ESP32C3
        default 1 if IDF_TARGET_ESP32C6
        help
            Bộ điều khiển UART: 0, 1 hoặc 2 (tùy chip có đủ UART).

endmenu

menu "PinManager — I2C"

    config PIN_I2C_SDA
        int "I2C SDA GPIO"
        default 21 if IDF_TARGET_ESP32
        default 6 if IDF_TARGET_ESP32C6
        default 9 if IDF_TARGET_ESP32C3
        help
            SDA — dùng trong code qua macro PIN_I2C_SDA.

    config PIN_I2C_SCL
        int "I2C SCL GPIO"
        default 22 if IDF_TARGET_ESP32
        default 7 if IDF_TARGET_ESP32C6
        default 8 if IDF_TARGET_ESP32C3
        help
            SCL — PIN_I2C_SCL.

    config PIN_I2C_PORT
        int "I2C port (I2C_NUM_0=0, I2C_NUM_1=1)"
        range 0 1
        default 0
        help
            Port I2C phần cứng.

    config PIN_I2C_CLK_HZ
        int "I2C tốc độ (Hz)"
        default 400000
        help
            Clock bus I2C master.

    config I2CDEV_TIMEOUT
        int "I2C dev mutex / giao dịch timeout (ms)"
        default 1000
        help
            Timeout mutex và i2c_master_cmd_begin (ms).

    config I2CDEV_NOLOCK
        bool "Tắt mutex I2Cdev (không thread-safe)"
        default n
        help
            Bật: truy cập I2C không khóa mutex.

endmenu
```

## MSMS_Project - C3/component/core/UartToGateWay/Kconfig.projbuild
```kconfig
menu "UART Gateway configuration"

    config UART_GATEWAY_BAUD_RATE
        int "UART gateway baudrate"
        default 115200
        help
            Baudrate for the UART link from mesh root to gateway.

endmenu
```

## MSMS_Project - C3/component/network/MeshManager/Kconfig.projbuild
```kconfig
menu "Wifi Mesh config"

    config IP_ROOT
        string "IP Root"
        default "192.168.5.1"
        help
            IP root to connect to.

    config UDP_PORT
        int "UDP Port"
        default 12345
        help
            WiFi password (WPA or WPA2) for the example to use.


endmenu
```

## MSMS_Project - C3/component/ui/ButtonManager/Kconfig.projbuild
```kconfig
menu "Button Manager"

    comment "ESP32 target uses fixed GPIO buttons: GPIO2=DOWN, GPIO35=SEL, GPIO39=BACK"
        depends on IDF_TARGET_ESP32

    config BUTTON_ANALOG_GPIO
        int "Analog button GPIO"
        depends on !IDF_TARGET_ESP32
        default 4 if IDF_TARGET_ESP32C6
        default 4 if IDF_TARGET_ESP32C3
        range 0 48
        help
            One ADC resistor-ladder button input. Used on ESP32-C3/C6 targets.

    config BUTTON_ANALOG_ATTEN_DB
        int "ADC attenuation (dB)"
        depends on !IDF_TARGET_ESP32
        default 0
        range 0 12
        help
            Use 0, 2, 6, or 12. Other values are rounded when initialized.

    config BUTTON_ANALOG_DOWN_MIN
        int "DOWN - ADC raw minimum"
        depends on !IDF_TARGET_ESP32
        default 2000
        range 0 4095

    config BUTTON_ANALOG_DOWN_MAX
        int "DOWN - ADC raw maximum"
        depends on !IDF_TARGET_ESP32
        default 2300
        range 0 4095

    config BUTTON_ANALOG_SEL_MIN
        int "SELECT - ADC raw minimum"
        depends on !IDF_TARGET_ESP32
        default 1300
        range 0 4095

    config BUTTON_ANALOG_SEL_MAX
        int "SELECT - ADC raw maximum"
        depends on !IDF_TARGET_ESP32
        default 1900
        range 0 4095

    config BUTTON_ANALOG_BACK_MIN
        int "BACK - ADC raw minimum"
        depends on !IDF_TARGET_ESP32
        default 3200
        range 0 4095

    config BUTTON_ANALOG_BACK_MAX
        int "BACK - ADC raw maximum"
        depends on !IDF_TARGET_ESP32
        default 3400
        range 0 4095

endmenu
```

## MSMS_Project/component/core/PinManager/Kconfig.projbuild
```kconfig
menu "PinManager — UART"

    config PIN_UART_TX
        int "UART TX GPIO"
        default 16 if IDF_TARGET_ESP32
        default 5 if IDF_TARGET_ESP32C6
        default 3 if IDF_TARGET_ESP32C3
        help
            Chân TX (GPIO) của UART đã chọn (UART port bên dưới).

    config PIN_UART_RX
        int "UART RX GPIO"
        default 17 if IDF_TARGET_ESP32
        default 4 if IDF_TARGET_ESP32C6
        default 2 if IDF_TARGET_ESP32C3
        help
            Chân RX (GPIO).

    config PIN_UART_NUM
        int "UART port (UART_NUM_0=0, UART_NUM_1=1, UART_NUM_2=2)"
        range 0 2 if IDF_TARGET_ESP32
        range 0 1 if IDF_TARGET_ESP32C3
        range 0 1 if IDF_TARGET_ESP32C6
        default 2 if IDF_TARGET_ESP32
        default 1 if IDF_TARGET_ESP32C3
        default 1 if IDF_TARGET_ESP32C6
        help
            Bộ điều khiển UART: 0, 1 hoặc 2 (tùy chip có đủ UART).

    config UART_GATEWAY_BAUD_RATE
        int "UART gateway baudrate"
        default 2000000
        help
            Baudrate for the UART link from mesh root to gateway.

    config UART_PERIPHERAL_BAUD_RATE
        int "UART peripheral baudrate"
        default 9600
        help
            Baudrate for peripheral sensors over UART.

endmenu

menu "PinManager — I2C"

    config PIN_I2C_SDA
        int "I2C SDA GPIO"
        default 21 if IDF_TARGET_ESP32
        default 6 if IDF_TARGET_ESP32C6
        default 9 if IDF_TARGET_ESP32C3
        help
            SDA — dùng trong code qua macro PIN_I2C_SDA.

    config PIN_I2C_SCL
        int "I2C SCL GPIO"
        default 22 if IDF_TARGET_ESP32
        default 7 if IDF_TARGET_ESP32C6
        default 8 if IDF_TARGET_ESP32C3
        help
            SCL — PIN_I2C_SCL.

    config PIN_I2C_PORT
        int "I2C port (I2C_NUM_0=0, I2C_NUM_1=1)"
        range 0 1
        default 0
        help
            Port I2C phần cứng.

    config PIN_I2C_CLK_HZ
        int "I2C tốc độ (Hz)"
        default 400000
        help
            Clock bus I2C master.

    config I2CDEV_TIMEOUT
        int "I2C dev mutex / giao dịch timeout (ms)"
        default 1000
        help
            Timeout mutex và i2c_master_cmd_begin (ms).

    config I2CDEV_NOLOCK
        bool "Tắt mutex I2Cdev (không thread-safe)"
        default n
        help
            Bật: truy cập I2C không khóa mutex.

endmenu

menu "PinManager — SPI"

    config PIN_SPI_HOST
        int "SPI Host ID"
        default 3
        help
            ID của SPI Host (ví dụ: 1 = SPI2_HOST, 2 = SPI3_HOST).

    config PIN_SPI_MISO
        int "SPI MISO GPIO"
        default 4
        help
            Chân MISO cho SPI Peripheral.

    config PIN_SPI_MOSI
        int "SPI MOSI GPIO"
        default 13
        help
            Chân MOSI cho SPI Peripheral.

    config PIN_SPI_SCLK
        int "SPI SCLK GPIO"
        default 15
        help
            Chân SCLK cho SPI Peripheral.

    config PIN_SPI_CS
        int "SPI CS GPIO"
        default 5
        help
            Chân CS (Chip Select) cho SPI Peripheral.

endmenu

menu "PinManager — Pulse"

    config PIN_PULSE_1
        int "Pulse 1 GPIO"
        default 26
        help
            Chân cấu hình cho Pulse 1 Peripheral (ví dụ DHT11/22).

    config PIN_PULSE_2
        int "Pulse 2 GPIO"
        default 25
        help
            Chân cấu hình cho Pulse 2 Peripheral.

endmenu
```

## MSMS_Project/component/drivers/MH-Z14A/Kconfig.projbuild
```kconfig
menu "MHZ14a configuration"

    config QUEUE_SIZE
        int "Max size queue"
        default 1
        help
            Max size queue for store capture PWM.

    choice MHZ14A_PROTOCOL_COMMUNICATION
        prompt "MHZ14a protocol"
        default MHZ14A_PWM
        help
            MHZ14a protocol communication to get data.

        config MHZ14A_PWM
            bool "PWM"
            default 0
            
        config MHZ14A_UART
            bool "UART"
            default 1
        
    endchoice

endmenu
```

## MSMS_Project/component/ui/ButtonManager/Kconfig.projbuild
```kconfig
menu "Button Manager"

    choice BUTTON_MODE
        prompt "Button Mode"
        default BUTTON_MODE_ANALOG
        help
            Select between Analog (ADC resistor ladder) or Digital (Discrete GPIOs).

        config BUTTON_MODE_ANALOG
            bool "Analog Button"
        config BUTTON_MODE_DIGITAL
            bool "Digital Button"
    endchoice

    menu "Analog Button Configuration"
        depends on BUTTON_MODE_ANALOG

        config BUTTON_ANALOG_GPIO
            int "Analog button GPIO"
            default 4 if IDF_TARGET_ESP32C6
            default 4 if IDF_TARGET_ESP32C3
            default 34
            range 0 48
            help
                One ADC resistor-ladder button input.

        config BUTTON_ANALOG_ATTEN_DB
            int "ADC attenuation (dB)"
            default 0
            range 0 12
            help
                Use 0, 2, 6, or 12. Other values are rounded when initialized.

        config BUTTON_ANALOG_DOWN_MIN
            int "DOWN - ADC raw minimum"
            default 2000
            range 0 4095

        config BUTTON_ANALOG_DOWN_MAX
            int "DOWN - ADC raw maximum"
            default 2300
            range 0 4095

        config BUTTON_ANALOG_SEL_MIN
            int "SELECT - ADC raw minimum"
            default 1300
            range 0 4095

        config BUTTON_ANALOG_SEL_MAX
            int "SELECT - ADC raw maximum"
            default 1900
            range 0 4095

        config BUTTON_ANALOG_BACK_MIN
            int "BACK - ADC raw minimum"
            default 3200
            range 0 4095

        config BUTTON_ANALOG_BACK_MAX
            int "BACK - ADC raw maximum"
            default 3400
            range 0 4095
    endmenu

    menu "Digital Button Configuration"
        depends on BUTTON_MODE_DIGITAL

        config BUTTON_DIGITAL_DOWN_GPIO
            int "DOWN Button GPIO"
            default 39

        config BUTTON_DIGITAL_SEL_GPIO
            int "SELECT Button GPIO"
            default 35

        config BUTTON_DIGITAL_BACK_GPIO
            int "BACK Button GPIO"
            default 2
            
        config BUTTON_DIGITAL_ACTIVE_LEVEL
            int "Active Level (0=Low, 1=High)"
            default 1
            range 0 1
            
        config BUTTON_DIGITAL_DEBOUNCE_MS
            int "Debounce Time (ms)"
            default 30
    endmenu

endmenu
```

## MeshGateWay/components/core/UartToNode/Kconfig.projbuild
```kconfig
menu "UART to Node"

    config UART_TO_NODE_ENABLE
        bool "Enable UART-to-node task"
        default y

    config UART_TO_NODE_UART_NUM
        int "UART port number (0/1/2)"
        range 0 2
        default 1

    config UART_TO_NODE_BAUDRATE
        int "UART baudrate"
        range 1200 2000000
        default 115200

    config UART_TO_NODE_TX_PIN
        int "TX GPIO"
        range -1 39
        default 17

    config UART_TO_NODE_RX_PIN
        int "RX GPIO"
        range -1 39
        default 16

    config UART_TO_NODE_RTS_PIN
        int "RTS GPIO (-1 = disable)"
        range -1 39
        default -1

    config UART_TO_NODE_CTS_PIN
        int "CTS GPIO (-1 = disable)"
        range -1 39
        default -1

    config UART_TO_NODE_SEND_PERIOD_MS
        int "Send period (ms)"
        range 50 5000
        default 500

    config UART_TO_NODE_RX_IDLE_RESET_MS
        int "Idle timeout to reset handshake (ms)"
        range 200 10000
        default 2000

    config UART_TO_NODE_TASK_STACK
        int "Task stack (words)"
        range 2048 16384
        default 4096

    config UART_TO_NODE_TASK_PRIO
        int "Task priority"
        range 1 25
        default 5

endmenu
```

## MeshGateWay/components/drivers/DS3231/Kconfig.projbuild
```kconfig
menu "DS3231 Configuration"

    config DS3231_I2C_PORT
        int "DS3231 I2C port"
        range 0 1
        default 0
        help
            Chon I2C port cho DS3231 (0 = I2C_NUM_0, 1 = I2C_NUM_1).

    config DS3231_SDA_GPIO
        int "DS3231 SDA GPIO"
        default 21
        help
            Chan SDA noi DS3231.

    config DS3231_SCL_GPIO
        int "DS3231 SCL GPIO"
        default 22
        help
            Chan SCL noi DS3231.

endmenu
```

## MeshGateWay/components/drivers/SD_Card/Kconfig.projbuild
```kconfig
menu "SD Card Configuration"

	config MISO_SDCARD
		int "MISO Pin"
		default 17
		help
			Config MISO Pin

	config MOSI_SDCARD
		int "MOSI Pin"
		default 18	
		help
			Config MOSI Pin

	config CLK_SDCARD
		int "CLK Pin"
		default 5
		help
			Config CLK Pin

	config CS_SDCARD
		int "CS Pin"
		default 19
		help
			Config CS Pin

	config SPI_HOST_SDCARD
		int "SPI Host"
		default 3
		help
			Config SPI Host
endmenu
```
