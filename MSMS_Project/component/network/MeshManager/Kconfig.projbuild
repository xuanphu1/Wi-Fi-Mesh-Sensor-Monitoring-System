## MSMS_Project/component/network/MeshManager/Kconfig.projbuild
```kconfig
menu "WiFi Mesh TCP config"

    config MESH_ROOT_FALLBACK_IP
        string "Fallback root IP"
        default "192.168.5.1"
        help
            Used when Mesh-Lite cannot report the root IP and the STA gateway
            is not available.

    config MESH_TCP_PORT
        int "Root TCP server port"
        range 1 65535
        default 8070
        help
            Port used for newline-delimited JSON telemetry.

    config MESH_TCP_MAX_CLIENTS
        int "Maximum simultaneous TCP nodes"
        range 1 8
        default 5
        help
            The root also consumes one listening socket. Increase
            CONFIG_LWIP_MAX_SOCKETS before raising this value.

    config MESH_TCP_SEND_INTERVAL_MS
        int "Telemetry interval (ms)"
        range 100 600000
        default 1000

    config MESH_TCP_CONNECT_TIMEOUT_MS
        int "TCP connect/send timeout (ms)"
        range 500 30000
        default 5000


endmenu
```

## MSMS_Project/main/Kconfig.projbuild
```kconfig
menu "MSMS Configuration"

    config MSMS_ENABLE_TESTS
        bool "Enable MSMS Architectural Test Suite"
        default n
        help
            Enables compilation of the MSMS architectural regression test suite.
            Disabled by default for production firmware.

endmenu
```

## MeshGateWay/components/core/WebSocKetHandle/Kconfig.projbuild
```kconfig
menu "WebSocKetHandle (WebSocket client)"

    choice WS_TARGET
        prompt "WebSocket data destination"
        default WS_TARGET_LOCAL
        help
            Select the default destination used by the gateway.

        config WS_TARGET_LOCAL
            bool "Local server (mDNS)"

        config WS_TARGET_SERVER
            bool "Internet server"
    endchoice

    config WS_LOCAL_URL
        string "Local WebSocket URI"
        default "ws://systemmsems.local:9090/ws"
        help
            Local WebSocket server advertised through mDNS as systemmsems.local.

    config WS_SERVER_URL
        string "Internet WebSocket URI"
        default "wss://systemmsems.msems.click/ws"
        help
            Public WebSocket server URI.

endmenu
```
